## sdkconfig.defaults
```kconfig
# Disable unused components to reduce binary size
CONFIG_BT_ENABLED=n
CONFIG_BT_BLUEDROID_ENABLED=n
CONFIG_BT_NIMBLE_ENABLED=n

# Disable Bluetooth
CONFIG_BTDM_CTRL_BR_EDR_MAX_ACL_CONN=0
CONFIG_BTDM_CTRL_BR_EDR_MAX_SYNC_CONN=0

# Disable unused protocols
CONFIG_LWIP_IPV6=n
CONFIG_LWIP_DHCP6=n
CONFIG_LWIP_DHCP6_STATEFUL=n
CONFIG_LWIP_DHCP6_STATELESS=n
CONFIG_ESP_MQTT_ENABLED=n

# Disable MDNS component (we're using custom implementation)
CONFIG_LWIP_MDNS=n

# Enable logging for debugging
CONFIG_LOG_DEFAULT_LEVEL_INFO=y
CONFIG_LOG_MAXIMUM_LEVEL_VERBOSE=y
CONFIG_BOOTLOADER_LOG_LEVEL_INFO=y

# Enable USB Serial JTAG console for ESP32-C6
CONFIG_ESP_CONSOLE_USB_SERIAL_JTAG=y
CONFIG_ESP_CONSOLE_SECONDARY_NONE=y
CONFIG_ESP_CONSOLE_USB_CDC_SUPPORT_ETS_PRINTF=y
CONFIG_ESP_CONSOLE_USB_SERIAL_JTAG_ENABLED=y

# Disable unnecessary features
CONFIG_ESP_COREDUMP_ENABLE=n
CONFIG_ESP_SYSTEM_PANIC_PRINT_HALT=y
CONFIG_ESP_SYSTEM_PANIC_REBOOT_DELAY_SECONDS=0

# Optimize newlib
CONFIG_NEWLIB_NANO_FORMAT=y

# Disable unused WiFi features
CONFIG_ESP_WIFI_SOFTAP_SUPPORT=n
CONFIG_ESP_WIFI_ENABLE_WPA3_SAE=n
CONFIG_ESP_WIFI_ENABLE_WPA3_OWE_STA=n
CONFIG_ESP_WIFI_WAPI_PSK=n
CONFIG_ESP_WIFI_SUITE_B_192=n
CONFIG_ESP_WIFI_11R_SUPPORT=n
CONFIG_ESP_WIFI_MBO_SUPPORT=n
CONFIG_ESP_WIFI_FTM_INITIATOR_SUPPORT=n
CONFIG_ESP_WIFI_FTM_RESPONDER_SUPPORT=n

# Disable WiFi provisioning
CONFIG_WIFI_PROV_ENABLE=n

# Disable unnecessary network features
CONFIG_LWIP_PPP_SUPPORT=n
CONFIG_LWIP_SLIP_SUPPORT=n
CONFIG_LWIP_NETIF_LOOPBACK=y

# Optimize compiler settings
CONFIG_COMPILER_OPTIMIZATION_SIZE=y
CONFIG_COMPILER_OPTIMIZATION_ASSERTIONS_DISABLE=y
CONFIG_COMPILER_OPTIMIZATION_CHECKS_SILENT=y

# Disable debug features
CONFIG_ESP_ERR_TO_NAME_LOOKUP=n

# Disable SPIFFS if not used
# CONFIG_SPIFFS_SUPPORT=n

# Disable fatfs if not used
# CONFIG_FATFS_SUPPORT=n

# Minimal task watchdog
CONFIG_ESP_TASK_WDT_INIT=n

# Disable ESP-NOW
CONFIG_ESP_WIFI_ESP_NOW_SUPPORT=n

# Reduce WiFi buffer sizes
CONFIG_ESP_WIFI_STATIC_RX_BUFFER_NUM=4
CONFIG_ESP_WIFI_DYNAMIC_RX_BUFFER_NUM=8
CONFIG_ESP_WIFI_TX_BUFFER_TYPE=0
CONFIG_ESP_WIFI_STATIC_TX_BUFFER_NUM=8
CONFIG_ESP_WIFI_CACHE_TX_BUFFER_NUM=8

# Reduce LWIP buffers
CONFIG_LWIP_MAX_SOCKETS=10
CONFIG_LWIP_TCP_MSS=536
CONFIG_LWIP_TCP_SND_BUF_DEFAULT=2144
CONFIG_LWIP_TCP_WND_DEFAULT=2144
CONFIG_LWIP_TCP_RECVMBOX_SIZE=4
CONFIG_LWIP_UDP_RECVMBOX_SIZE=4
CONFIG_LWIP_TCPIP_RECVMBOX_SIZE=8

# Disable unnecessary protocols
CONFIG_LWIP_AUTOIP=n
CONFIG_LWIP_IGMP=n
CONFIG_LWIP_SNTP=n

# Enable HTTP server (using ESP-IDF's esp_http_server component)
CONFIG_ESP_HTTP_SERVER_ENABLE=y
CONFIG_ESP_HTTP_CLIENT_ENABLE_HTTPS=n

# Disable mbed TLS features not needed
CONFIG_MBEDTLS_SSL_PROTO_TLS1=n
CONFIG_MBEDTLS_SSL_PROTO_TLS1_1=n
CONFIG_MBEDTLS_CERTIFICATE_BUNDLE=n
CONFIG_MBEDTLS_HARDWARE_AES=y
CONFIG_MBEDTLS_HARDWARE_SHA=y

# Disable OTA if not used
# CONFIG_OTA_ALLOW_HTTP=n

# Reduce FreeRTOS overhead
CONFIG_FREERTOS_ASSERT_DISABLE=y
CONFIG_FREERTOS_WATCHPOINT_END_OF_STACK=n
```
